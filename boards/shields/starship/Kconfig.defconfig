## boards/shields/starship/Kconfig.defconfig
```kconfig
if SHIELD_STARSHIP_LEFT

config ZMK_KEYBOARD_NAME
	default "Starship Rev.1"

config ZMK_SPLIT_ROLE_CENTRAL
	default y

endif

if SHIELD_STARSHIP_LEFT || SHIELD_STARSHIP_RIGHT

config ZMK_SPLIT
	default y

endif
```

## boards/shields/starship/Kconfig.shield
```kconfig
config SHIELD_STARSHIP_LEFT
	def_bool $(shields_list_contains,starship_left)

config SHIELD_STARSHIP_RIGHT
	def_bool $(shields_list_contains,starship_right)
```
